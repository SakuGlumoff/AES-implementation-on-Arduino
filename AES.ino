#define Nb 4
#define Nk 4
#define Nr 10
uint8_t state[16];
uint16_t aika;
const uint8_t subsBox[256] = {
  0x63, 0x7c, 0x77, 0x7b, 0xf2, 0x6b, 0x6f, 0xc5, 0x30, 0x01, 0x67, 0x2b, 0xfe, 0xd7, 0xab, 0x76,
  0xca, 0x82, 0xc9, 0x7d, 0xfa, 0x59, 0x47, 0xf0, 0xad, 0xd4, 0xa2, 0xaf, 0x9c, 0xa4, 0x72, 0xc0,
  0xb7, 0xfd, 0x93, 0x26, 0x36, 0x3f, 0xf7, 0xcc, 0x34, 0xa5, 0xe5, 0xf1, 0x71, 0xd8, 0x31, 0x15,
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  0x8c, 0xa1, 0x89, 0x0d, 0xbf, 0xe6, 0x42, 0x68, 0x41, 0x99, 0x2d, 0x0f, 0xb0, 0x54, 0xbb, 0x16
};
const uint8_t invSubBox[256] = {
  0x52, 0x09, 0x6a, 0xd5, 0x30, 0x36, 0xa5, 0x38, 0xbf, 0x40, 0xa3, 0x9e, 0x81, 0xf3, 0xd7, 0xfb,
  0x7c, 0xe3, 0x39, 0x82, 0x9b, 0x2f, 0xff, 0x87, 0x34, 0x8e, 0x43, 0x44, 0xc4, 0xde, 0xe9, 0xcb,
  0x54, 0x7b, 0x94, 0x32, 0xa6, 0xc2, 0x23, 0x3d, 0xee, 0x4c, 0x95, 0x0b, 0x42, 0xfa, 0xc3, 0x4e,
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  0x17, 0x2b, 0x04, 0x7e, 0xba, 0x77, 0xd6, 0x26, 0xe1, 0x69, 0x14, 0x63, 0x55, 0x21, 0x0c, 0x7d
};
const uint8_t rconSmall[11] = {
  0x8d, 0x01, 0x02, 0x04, 0x08, 0x10, 0x20, 0x40, 0x80, 0x1b, 0x36
};
uint8_t key[] = { 0x2b, 0x7e, 0x15, 0x16, 0x28, 0xae, 0xd2, 0xa6, 0xab, 0xf7, 0x15, 0x88, 0x09, 0xcf, 0x4f, 0x3c };
uint8_t in[] = {0x32, 0x43, 0xf6, 0xa8, 0x88, 0x5a, 0x30, 0x8d, 0x31, 0x31, 0x98, 0xa2, 0xe0, 0x37, 0x07, 0x34};
uint8_t KeyWord[176];
void KeyExpansion() {
  uint16_t i = 0;
  uint8_t temp[4];
  while (i < Nk) {
    KeyWord[(i * 4)] = key[(i * 4)];
    KeyWord[(i * 4) + 1] = key[(i * 4) + 1];
    KeyWord[(i * 4) + 2] = key[(i * 4) + 2];
    KeyWord[(i * 4) + 3] = key[(i * 4) + 3];
    i++;
  }

  i = Nk;
  while (i < (Nb * (Nr + 1))) {
    for (int j = 0; j < 4; j++) {
      temp[j] = KeyWord[(i - 1) * 4 + j];
    }
    if (i % Nk == 0) {
      //RotKeyWord schedule
      uint8_t apu = temp[0];
      for (int j = 0; j < 3; j++) {
        temp[j] = temp[j + 1];
      }
      temp[3] = apu;


      //SubKeyWord schedule
      for (int j = 0; j < 4; j++) {
        temp[j] = subsBox[temp[j]];
      }

      //XOR w/ Rcon
      temp[0] ^= rconSmall[i / Nk];

    }
    else if ((Nk > 6) && (i % Nk == 4)) {
      //SubKeyWord schedule
      for (int j = 0; j < 4; j++) {
        temp[j] = subsBox[temp[j]];
      }
    }
    for (int j = 0; j < 4; j++) {
      KeyWord[(i * 4) + j] =  KeyWord[((i - Nk) * 4) + j] ^ temp[j];
    }
    i++;
  }
}

void Cipher() {
  KeyExpansion();
  uint8_t i;
  for (int a = 0; a < 16; a++) {
    state[a] = in[a];
  }
  //First AddRoundKey
  for (int a = 0; a < 16; a++) {
    state[a] ^= KeyWord[a];
  }
  //start of for-loop
  for (i = 1; i < Nr; i++) {
    //SubBytes routine
    for (int j = 0; j < 16; j++) {
      state[j] = subsBox[state[j]];
    }

    ShiftRows();

    //MixColumns routine
    MixColumns();

    //AddRoundKey routine
    for (int j = 0; j < 4; j++) {
      for (int k = 0; k < 4; k++) {
        state[(j * 4) + k] ^= KeyWord[(i * Nb * 4) + (j * Nb) + k];
      }
    }
  } //end of for-loop and start of last round

  //SubBytes routine
  for (int i = 0; i < 16; i++) {
    state[i] = subsBox[state[i]];
  }
  //ShiftRows routine
  ShiftRows();
  //AddRoundKey
  for (int j = 0; j < 4; j++) {
    for (int k = 0; k < 4; k++) {
      state[(j * 4) + k] ^= KeyWord[(i * Nb * 4) + (j * Nb) + k];
    }
  }
}
uint8_t xtime(uint8_t x)
{
  return ((x << 1) ^ (((x >> 7) & 1) * 0x1b));
}
void MixColumns() {
  uint8_t Tmp, Tm, t;
  for (int a = 0; a < 4; a++) {
    t = state[(a * 4) + 0];
    Tmp = state[(a * 4) + 0] ^ state[(a * 4) + 1] ^ state[(a * 4) + 2] ^ state[(a * 4) + 3];
    Tm = state[(a * 4) + 0] ^ state[(a * 4) + 1]; Tm = xtime(Tm); state[(a * 4) + 0] ^= Tm ^ Tmp;
    Tm = state[(a * 4) + 1] ^ state[(a * 4) + 2]; Tm = xtime(Tm); state[(a * 4) + 1] ^= Tm ^ Tmp;
    Tm = state[(a * 4) + 2] ^ state[(a * 4) + 3]; Tm = xtime(Tm); state[(a * 4) + 2] ^= Tm ^ Tmp;
    Tm = state[(a * 4) + 3] ^ t; Tm = xtime(Tm); state[(a * 4) + 3] ^= Tm ^ Tmp;
  }
}
void InvMixColumns() {
  uint8_t a, b, c, d;
  for (int i = 0; i < 4; ++i)
  {
    a = state[(i * 4) + 0];
    b = state[(i * 4) + 1];
    c = state[(i * 4) + 2];
    d = state[(i * 4) + 3];

    state[(i * 4) + 0] = Multiply(a, 0x0e) ^ Multiply(b, 0x0b) ^ Multiply(c, 0x0d) ^ Multiply(d, 0x09);
    state[(i * 4) + 1] = Multiply(a, 0x09) ^ Multiply(b, 0x0e) ^ Multiply(c, 0x0b) ^ Multiply(d, 0x0d);
    state[(i * 4) + 2] = Multiply(a, 0x0d) ^ Multiply(b, 0x09) ^ Multiply(c, 0x0e) ^ Multiply(d, 0x0b);
    state[(i * 4) + 3] = Multiply(a, 0x0b) ^ Multiply(b, 0x0d) ^ Multiply(c, 0x09) ^ Multiply(d, 0x0e);
  }
}
uint8_t Multiply(uint8_t x, uint8_t y)
{
  return (((y & 1) * x) ^
          ((y >> 1 & 1) * xtime(x)) ^
          ((y >> 2 & 1) * xtime(xtime(x))) ^
          ((y >> 3 & 1) * xtime(xtime(xtime(x)))) ^
          ((y >> 4 & 1) * xtime(xtime(xtime(xtime(x))))));
}
void ShiftRows() {
  uint8_t apu, apu1;
  //second row
  apu = state[1];
  state[1] = state[5];
  state[5] = state[9];
  state[9] = state[13];
  state[13] = apu;
  //third row
  apu = state[2];
  apu1 = state[6];
  state[2] = state[10];
  state[6] = state[14];
  state[10] = apu;
  state[14] = apu1;
  //fourth row
  apu = state[3];
  state[3] = state[15];
  state[15] = state[11];
  state[11] = state[7];
  state[7] = apu;
}
void InvShiftRows() {
  uint8_t apu;
  //second row
  apu = state[13];
  state[13] = state[9];
  state[9] = state[5];
  state[5] = state[1];
  state[1] = apu;
  //third row
  apu = state[2];
  state[2] = state[10];
  state[10] = apu;
  apu = state[6];
  state[6] = state[14];
  state[14] = apu;
  //fourth row
  apu = state[3];
  state[3] = state[7];
  state[7] = state[11];
  state[11] = state[15];
  state[15] = apu;
}
void InvCipher() {
  //AddRoundKey before loop
  for (int j = 0; j < 4; j++) {
    for (int k = 0; k < 4; k++) {
      state[(j * 4) + k] ^= KeyWord[(Nr * Nb * 4) + (j * Nb) + k];
    }
  }
  //start of for loop
  for (int i = (Nr - 1); i > 0; i--) {
    //InvShiftRows
    InvShiftRows();
    //InvSubBytes
    for (int i = 0; i < 16; i++) {
      state[i] = invSubBox[state[i]];
    }
    //AddRoundKey
    for (int j = 0; j < 4; j++) {
      for (int k = 0; k < 4; k++) {
        state[(j * 4) + k] ^= KeyWord[(i * Nb * 4) + (j * Nb) + k];
      }
    }
    //InvMixColumns
    InvMixColumns();
  }//end of for loop

  //InvShiftRows
  InvShiftRows();
  //InvSubBytes
  for (int i = 0; i < 16; i++) {
    state[i] = invSubBox[state[i]];
  }
  //AddRoundKey
  for (int j = 0; j < 4; j++) {
    for (int k = 0; k < 4; k++) {
      state[(j * 4) + k] ^= KeyWord[(0 * Nb * 4) + (j * Nb) + k];
    }
  }
}
void setup() {
  Serial.begin(9600);
  Serial.println("Give me a 16-character text to cipher.");
}

void loop() {
  if (Serial.available() > 15) {
    aika = millis();
    char inputArray[16];
    for (int i = 0; i < 16; i++) {
      inputArray[i] = Serial.read();
      in[i] = (uint8_t)inputArray[i];
    }
    Serial.println("Message to encrypt: ");
    for (int i = 0; i < 16; i++) {
      Serial.print(inputArray[i]);
    }
    Serial.print("\n");
    Cipher();
    Serial.println("Output: ");
    for (int k = 0; k < 16; k++) {
      Serial.print((char)state[k]);
    }
    Serial.print("\n");
    Serial.print("Process from start of the encryption to the output took "); Serial.print((millis() - aika)); Serial.println(" ms");
    Serial.println("Starting decipher process.");
    aika = millis();
    InvCipher();
    Serial.println("Output: ");
    for (int k = 0; k < 16; k++) {
      Serial.print((char)state[k]);
    }
    Serial.print("\n");
    Serial.print("Process from start of the decryption to the output took "); Serial.print((millis() - aika)); Serial.println(" ms");
    Serial.print("\n");
    Serial.flush();
    aika = 0;
  }
}
